## config/boards/shields/slate/Kconfig.defconfig
```kconfig
if SHIELD_SLATE_LEFT

	config ZMK_KEYBOARD_NAME
		default "Slate"
	
	config ZMK_SPLIT_BLE_ROLE_CENTRAL
		default y

endif

if SHIELD_SLATE_RIGHT

	config ZMK_KEYBOARD_NAME
		default "Slate Right"
		
endif

if SHIELD_SLATE_LEFT || SHIELD_SLATE_RIGHT

	config ZMK_SPLIT
		default y

endif
```

## zmk-config-slate/config/boards/shields/apt/Kconfig.defconfig
```kconfig
if SHIELD_APT_LEFT

	config ZMK_KEYBOARD_NAME
		default "Slate Left"
	
	config ZMK_SPLIT_BLE_ROLE_CENTRAL
		default y

endif

if SHIELD_APT_RIGHT

	config ZMK_KEYBOARD_NAME
		default "Slate Right"
		
endif

if SHIELD_APT_LEFT || SHIELD_APT_RIGHT

	config ZMK_SPLIT
		default y

endif
```
